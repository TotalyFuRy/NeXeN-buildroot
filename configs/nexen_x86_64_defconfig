## configs/nexen_x86_64_defconfig
```kconfig
# Architecture
BR2_x86_64=y

# System
BR2_SYSTEM_DHCP="eth0"
BR2_TARGET_GENERIC_GETTY_PORT="tty1"

# Filesystem
BR2_TARGET_ROOTFS_EXT2=y
# BR2_TARGET_ROOTFS_TAR is not set

# Kernel
BR2_LINUX_KERNEL=y
BR2_LINUX_KERNEL_LATEST_VERSION=y
BR2_LINUX_KERNEL_PATCH="mptcp-v4.18-4b41ddb989ae.patch"
BR2_LINUX_KERNEL_USE_CUSTOM_CONFIG=y
BR2_LINUX_KERNEL_CUSTOM_CONFIG_FILE="board/qemu/x86_64/linux.config"
BR2_LINUX_KERNEL_CONFIG_FRAGMENT_FILES="kernel-config-frag"

# Shadowsocks-libev
BR2_PACKAGE_SHADOWSOCKS_LIBEV=y
BR2_PACKAGE_SHADOWSOCKS_LIBEV_CONNMARKTOS=y

# glorytun
BR2_PACKAGE_GLORYTUN=y
```
